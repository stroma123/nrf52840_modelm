## boards/arm/modelm/Kconfig.board
```kconfig
# Copyright (c) 2023 The ZMK Contributers
# SPDX-Licencse-Identifier: MIT

config BOARD_IBM_MODELM
    bool "IBM Model M"
    depends on SOC_NRF52840_QIAA
```

## boards/arm/modelm_v4/Kconfig.board
```kconfig
# Copyright (c) 2023 The ZMK Contributers
# SPDX-Licencse-Identifier: MIT

config BOARD_IBM_MODELM_V4
    bool "IBM Model M4"
    depends on SOC_NRF52840_QIAA
```

## boards/arm/modelm_v4/Kconfig.defconfig
```kconfig
# Copyright (c) 2023 The ZMK Contributers
# SPDX-Licencse-Identifier: MIT

if BOARD_IBM_MODELM_V4

config BOARD
	default "modelm_v4"

config ZMK_KEYBOARD_NAME
    default "IBM Model M4"

if USB_DEVICE_STACK

config USB_NRFX
    default y

endif # USB_DEVICE_STACK

config BT_CTLR
    default BT

config ZMK_BLE
    default y

config ZMK_USB
    default y

config ZMK_RTT_LOGGING
    default n

config LOG_BACKEND_SHOW_COLOR
    default n

config LED
    default y

config LED_LOCK_STATUS
    bool "Enable LED lock indicators, such as Caps lock, Num Lock ..."
    default n

config PWMLED_LOCK_STATUS
    depends on !LED_LOCK_STATUS
    bool "Enable PWM LED lock indicators, such as Caps lock, Num Lock ..."
    default n

config INDICATOR_LED_STATUS
    bool "Enable blink LED status indicator for showing battery and output status"
    default n

config INDICATOR_LED_STATUS_SEQ
    depends on !INDICATOR_LED_STATUS
    bool "Enable blink LED sequences for showing battery, active layer and output status"

if INDICATOR_LED_STATUS || INDICATOR_LED_STATUS_SEQ
config LED
    default y

config INDICATOR_LED_ON_TIME_MS
    int "Indicator LED ON state duration in ms"
    default 300

config INDICATOR_LED_OFF_TIME_MS
    int "Indicator LED OFF state duration in ms"
    default 150

config INDICATOR_LED_SHOW_LAYER_CHANGE
    bool "Indicate highest active layer on each layer change with a sequence of blinks"
        default y

config INDICATOR_LED_LAYER_PERSISTENCE_THRESHOLD
    int "At which layer number (starting from 0) should the LED stay lit after its blink sequence, to indicate a non-default layer is still active."
        default 200

config INDICATOR_LED_SHOW_BATTERY_ON_BOOT
    bool "Indicate battery level on startup with a sequence of blinks"
        default y

config INDICATOR_LED_SHOW_CRITICAL_BATTERY_CHANGES
    bool "Blink once every time battery level changes when below critical level"
        default y

config INDICATOR_LED_SHOW_BLE
    bool "Indicate BLE status on startup and profile change with a sequence of blinks"
        default y

config INDICATOR_LED_SHOW_PERIPHERAL_BLE
    bool "Indicate on the peripheral half of a split what its connection status is, with a sequence of blinks."
        default y
    depends on INDICATOR_LED_SHOW_BLE
        help
            Requires INDICATOR_LED_SHOW_BLE to be enabled.

config INDICATOR_LED_SEQ_INTERVAL_MS
    int "Minimum wait duration between blink sequences in ms"
    default 500

config INDICATOR_LED_BATTERY_LEVEL_HIGH
    int "High battery level percentage"
    default 80

config INDICATOR_LED_BATTERY_LEVEL_LOW
    int "Low battery level percentage"
    default 20

config INDICATOR_LED_BATTERY_LEVEL_CRITICAL
    int "Critical battery level percentage"
    default 5

config INDICATOR_LED_BATTERY_HIGH_BLINK_REPEAT
    int "High battery level blink repeat count"
    default 2

config INDICATOR_LED_BATTERY_LOW_BLINK_REPEAT
    int "Low battery level blink repeat count"
    default 4

config INDICATOR_LED_BATTERY_CRITICAL_BLINK_REPEAT
    int "Critical battery level blink repeat count"
    default 6

endif # I# INDICATOR_LED_STATUS || INDICATOR_LED_STATUS_SEQ

config ANTIGHOST
    bool "Enable basic anti-ghost support"
    default n

config ANTIGHOST_V2
    bool "Enable advanced anti-ghost support"
    default n

config USE_DT_CODE_PARTITION
    default y

#config ZMK_KSCAN_MATRIX_WAIT_BETWEEN_OUTPUTS
#    default 0

#config ZMK_KSCAN_MATRIX_WAIT_BEFORE_INPUTS
#    default 5

endif # BOARD_IBM_MODELM_V4
```

## boards/arm/modelm_v4/modelm_v4_defconfig
```kconfig
# Copyright (c) 2023 The ZMK Contributers
# SPDX-Licencse-Identifier: MIT

CONFIG_SOC_SERIES_NRF52X=y
CONFIG_SOC_NRF52840_QIAA=y
CONFIG_BOARD_IBM_MODELM=y

# Enable deep sleep support. Type:bool Default:n
CONFIG_ZMK_SLEEP=y
# Milliseconds of inactivity before entering idle state. Type:int Default:30000 (30 seconds)
CONFIG_ZMK_IDLE_TIMEOUT=30000
# Milliseconds of inactivity before entering deep sleep. Type:int Default:900000 (15 minutes)
CONFIG_ZMK_IDLE_SLEEP_TIMEOUT=900000

# Enable MPU
CONFIG_ARM_MPU=y

# system setup
CONFIG_ARM_MPU=y
CONFIG_MPU_ALLOW_FLASH_WRITE=y
CONFIG_NVS=y
CONFIG_SETTINGS_NVS=y
CONFIG_FLASH=y
CONFIG_FLASH_PAGE_LAYOUT=y
CONFIG_FLASH_MAP=y
CONFIG_USE_DT_CODE_PARTITION=y
CONFIG_BUILD_OUTPUT_UF2=y

# enable GPIO
CONFIG_GPIO=y
CONFIG_PINCTRL=y

# config ZMK
CONFIG_ZMK_USB=y
CONFIG_ZMK_BLE=y
CONFIG_ZMK_BATTERY_REPORTING=y
CONFIG_ZMK_BATTERY_REPORT_INTERVAL=120
CONFIG_ZMK_BLE_PASSKEY_ENTRY=y
CONFIG_ZMK_BLE_EXPERIMENTAL_FEATURES=y
CONFIG_ZMK_BLE_EXPERIMENTAL_CONN=y
CONFIG_ZMK_BLE_CLEAR_BONDS_ON_START=n
CONFIG_ZMK_EXT_POWER=n

# matrix scanning
CONFIG_ZMK_KSCAN_MATRIX_POLLING=n
CONFIG_ZMK_KSCAN_MATRIX_WAIT_BETWEEN_OUTPUTS=0
CONFIG_ZMK_KSCAN_MATRIX_WAIT_BEFORE_INPUTS=15

# Windows Battery Reporting Fix
CONFIG_BT_GATT_ENFORCE_SUBSCRIPTION=n

# LED indicators
CONFIG_LED=y
CONFIG_ZMK_HID_INDICATORS=y
CONFIG_PWM=y
CONFIG_LED_PWM=y

# ZMK Studio support
CONFIG_ZMK_STUDIO=y
CONFIG_ZMK_STUDIO_LOCKING=n

# uncomment to enable USB logging / debugging
# CONFIG_ZMK_USB_LOGGING=y
# CONFIG_ZMK_LOG_LEVEL_DBG=y
# CONFIG_LOG_PROCESS_THREAD_STARTUP_DELAY_MS=6000

# BLE/BATTERY/LAYER LED indicator
CONFIG_INDICATOR_LED_STATUS=y
CONFIG_INDICATOR_LED_STATUS_SEQ=n
CONFIG_INDICATOR_LED_SHOW_LAYER_CHANGE=n

# Lock LED indicators Num, Caps, Scroll
CONFIG_LED_LOCK_STATUS=n
CONFIG_PWMLED_LOCK_STATUS=y

# Anti-ghosting
CONFIG_ANTIGHOST_V2=y
```

## boards/arm/nrf52840_modelm/Kconfig
```kconfig
# Copyright (c) 2023 The ZMK Contributers
# SPDX-Licencse-Identifier: MIT

config BOARD_ENABLE_DCDC
    bool "Enable DCDC mode"
    select SOC_DCDC_NRF52X
    default y
    depends on BOARD_IBM_MODELM

config BOARD_ENABLE_DCDC_HV
    bool "High voltage DCDC converter"
    select SOC_DCDC_NRF52X_HV
    default y
    depends on BOARD_IBM_MODELM
```

## boards/arm/nrf52840_modelm/Kconfig.defconfig
```kconfig
# Copyright (c) 2023 The ZMK Contributers
# SPDX-Licencse-Identifier: MIT

if BOARD_IBM_MODELM

config BOARD
	default "nrf52840_modelm"

config ZMK_KEYBOARD_NAME
    default "IBM Model M"

if USB_DEVICE_STACK

config USB_NRFX
    default y

endif # USB_DEVICE_STACK

config BT_CTLR
    default BT

config ZMK_BLE
    default y

config ZMK_USB
    default y

config ZMK_RTT_LOGGING
    default n

config LOG_BACKEND_SHOW_COLOR
    default n

config LED
    default y

config LED_LOCK_STATUS
    bool "Enable LED lock indicators, such as Caps lock, Num Lock ..."
    default n

config LED_INDICATOR_STATUS
    bool "Enable LED status indicator"
    default n

config LED_INDICATOR_BLINK_MS
    int "Duration of BLE connection status blink in ms"
    default 300

config LED_INDICATOR_INTERVAL_MS
    int "Minimum wait duration between two blinks in ms"
    default 150

config LED_INDICATOR_BATTERY_LEVEL_CRITICAL
    int "Critical battery level percentage"
    default 5

config USE_DT_CODE_PARTITION
    default y

#config ZMK_KSCAN_MATRIX_WAIT_BETWEEN_OUTPUTS
#    default 0

#config ZMK_KSCAN_MATRIX_WAIT_BEFORE_INPUTS
#    default 5

endif # BOARD_IBM_MODELM
```

## boards/arm/nrf52840_modelm/nrf52840_modelm_defconfig
```kconfig
# Copyright (c) 2023 The ZMK Contributers
# SPDX-Licencse-Identifier: MIT

CONFIG_SOC_SERIES_NRF52X=y
CONFIG_SOC_NRF52840_QIAA=y
CONFIG_BOARD_IBM_MODELM=y

# Enable deep sleep
CONFIG_ZMK_SLEEP=y

# Enable MPU
CONFIG_ARM_MPU=y

# system setup
CONFIG_ARM_MPU=y
CONFIG_MPU_ALLOW_FLASH_WRITE=y
CONFIG_NVS=y
CONFIG_SETTINGS_NVS=y
CONFIG_FLASH=y
CONFIG_FLASH_PAGE_LAYOUT=y
CONFIG_FLASH_MAP=y
CONFIG_USE_DT_CODE_PARTITION=y
CONFIG_BUILD_OUTPUT_UF2=y

# enable GPIO
CONFIG_GPIO=y
CONFIG_GPIO_AS_PINRESET=y
CONFIG_PINCTRL=y

# config ZMK
CONFIG_ZMK_USB=y
CONFIG_ZMK_BLE=y
CONFIG_ZMK_BATTERY_REPORTING=y
CONFIG_ZMK_BATTERY_REPORT_INTERVAL=120
CONFIG_ZMK_BLE_PASSKEY_ENTRY=y
CONFIG_ZMK_BLE_EXPERIMENTAL_FEATURES=y
CONFIG_ZMK_BLE_EXPERIMENTAL_CONN=y

# Windows Battery Reporting Fix
CONFIG_BT_GATT_ENFORCE_SUBSCRIPTION=n

# LED indicators
CONFIG_LED=y
CONFIG_ZMK_HID_INDICATORS=y

# ZMK Studio support
# CONFIG_ZMK_STUDIO_LOCKING=n
# CONFIG_ZMK_STUDIO=y

# uncomment to enable USB logging / debugging
# CONFIG_ZMK_USB_LOGGING=y
# CONFIG_ZMK_LOG_LEVEL_DBG=y
# CONFIG_LOG_PROCESS_THREAD_STARTUP_DELAY_MS=3000
```

## boards/shields/model_x/Kconfig.defconfig
```kconfig
if SHIELD_MODEL_X

config ZMK_KEYBOARD_NAME
    default "Model X"

config SPI
    default y

if USB_DEVICE_STACK

config USB_NRFX
    default y

endif # USB_DEVICE_STACK

config BT_CTLR
    default BT

config ZMK_BLE
    default y

config ZMK_USB
    default y

config ZMK_RTT_LOGGING
    default n

config LOG_BACKEND_SHOW_COLOR
    default n

config LED
    default y

config LED_LOCK_STATUS
    bool "Enable LED lock indicators, such as Caps lock, Num Lock ..."
    default n

config PWMLED_LOCK_STATUS
    bool "Enable PWM LED lock indicators, such as Caps lock, Num Lock ..."
    default n

config LED_INDICATOR_STATUS
    bool "Enable LED status indicator"
    default n

config LED_INDICATOR_BLINK_MS
    int "Duration of BLE connection status blink in ms"
    default 300

config LED_INDICATOR_INTERVAL_MS
    int "Minimum wait duration between two blinks in ms"
    default 150

config LED_INDICATOR_BATTERY_LEVEL_CRITICAL
    int "Critical battery level percentage"
    default 5

config USE_DT_CODE_PARTITION
    default y

endif
```

## config/west.yml
```yaml
manifest:
  remotes:
    - name: zmkfirmware
      url-base: https://github.com/zmkfirmware
    - name: modelm
      url-base: https://github.com/stroma123/nrf52840_modelm      
    # Additional modules containing boards/shields/custom code can be listed here as well
    # See https://docs.zephyrproject.org/3.2.0/develop/west/manifest.html#projects
  projects:
    - name: zmk
      remote: zmkfirmware
      revision: v0.3
      import: app/west.yml
  self:
    path: config
```
